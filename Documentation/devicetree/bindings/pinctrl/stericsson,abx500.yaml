## Documentation/devicetree/bindings/pinctrl/stericsson,abx500.yaml
```yaml
# SPDX-License-Identifier: (GPL-2.0-only OR BSD-2-Clause)
%YAML 1.2
---
$id: http://devicetree.org/schemas/pinctrl/stericsson,abx500.yaml#
$schema: http://devicetree.org/meta-schemas/core.yaml#

title: ST-Ericsson AB8500 and AB8505 GPIO and pin controller

maintainers:
  - Linus Walleij <linusw@kernel.org>

properties:
  compatible:
    enum:
      - stericsson,ab8500-gpio
      - stericsson,ab8505-gpio

  gpio-controller: true

  '#gpio-cells':
    const: 2

  gpio-line-names:
    minItems: 1
    maxItems: 53

patternProperties:
  '^(?!phandle$|compatible$|gpio-controller$|gpio-line-names$|pinctrl-[0-9]+$|pinctrl-names$)[a-zA-Z0-9_-]+$':
    $ref: '#/$defs/config-node'

required:
  - compatible
  - gpio-controller
  - '#gpio-cells'

additionalProperties: false

$defs:
  config-node:
    type: object
    allOf:
      - $ref: pincfg-node.yaml#
      - $ref: pinmux-node.yaml#
    patternProperties:
      '^(?!phandle$|pins$|groups$|function$|bias-.*$|drive-.*$|input-.*$|output-.*$|power-source$|slew-rate$|low-power-.*$|persist-state$|skew-delay$)[a-zA-Z0-9_-]+$':
        $ref: '#/$defs/config-node'
    unevaluatedProperties: false

examples:
  - |
    gpio {
        compatible = "stericsson,ab8500-gpio";
        gpio-controller;
        #gpio-cells = <2>;

        sysclkreq2 {
            sysclkreq2-default {
                mux {
                    function = "sysclkreq";
                    groups = "sysclkreq2_d_1";
                };
                config {
                    pins = "GPIO1";
                    bias-disable;
                };
            };
        };
    };
```

## Documentation/devicetree/bindings/pinctrl/stericsson,nomadik.yaml
```yaml
# SPDX-License-Identifier: (GPL-2.0-only OR BSD-2-Clause)
%YAML 1.2
---
$id: http://devicetree.org/schemas/pinctrl/stericsson,nomadik.yaml#
$schema: http://devicetree.org/meta-schemas/core.yaml#

title: ST-Ericsson Nomadik pin controller

maintainers:
  - Linus Walleij <linusw@kernel.org>

properties:
  compatible:
    enum:
      - stericsson,db8500-pinctrl
      - stericsson,stn8815-pinctrl

  nomadik-gpio-chips:
    description: GPIO banks providing the pin control registers.
    $ref: /schemas/types.yaml#/definitions/phandle-array
    minItems: 1
    maxItems: 9
    items:
      maxItems: 1

  prcm:
    description: PRCMU controlling the alternate pin functions.
    $ref: /schemas/types.yaml#/definitions/phandle

patternProperties:
  '^(?!phandle$|compatible$|nomadik-gpio-chips$|prcm$|pinctrl-[0-9]+$|pinctrl-names$)[a-zA-Z0-9_-]+$':
    $ref: '#/$defs/config-node'

required:
  - compatible
  - nomadik-gpio-chips

additionalProperties: false

$defs:
  config-node:
    type: object
    properties:
      function:
        $ref: /schemas/types.yaml#/definitions/string
      groups:
        $ref: /schemas/types.yaml#/definitions/string-array
      pins:
        $ref: /schemas/types.yaml#/definitions/string-array
      ste,config:
        description: Shared pin configuration to apply.
        $ref: /schemas/types.yaml#/definitions/phandle
      ste,input:
        description: Input pull configuration.
        $ref: /schemas/types.yaml#/definitions/uint32
        maximum: 2
      ste,output:
        description: Output value.
        $ref: /schemas/types.yaml#/definitions/uint32
        maximum: 2
      ste,gpio:
        description: GPIO mode enable.
        $ref: /schemas/types.yaml#/definitions/uint32
        maximum: 1
      ste,sleep:
        description: Sleep mode enable.
        $ref: /schemas/types.yaml#/definitions/uint32
        maximum: 1
      ste,sleep-input:
        description: Sleep input pull configuration.
        $ref: /schemas/types.yaml#/definitions/uint32
        maximum: 3
      ste,sleep-output:
        description: Sleep output value.
        $ref: /schemas/types.yaml#/definitions/uint32
        maximum: 2
      ste,sleep-gpio:
        description: Sleep GPIO mode enable.
        $ref: /schemas/types.yaml#/definitions/uint32
        maximum: 1
      ste,sleep-wakeup:
        description: Sleep wakeup disable.
        $ref: /schemas/types.yaml#/definitions/uint32
        maximum: 1
      ste,sleep-pull-disable:
        description: Sleep pull resistor disable.
        $ref: /schemas/types.yaml#/definitions/uint32
        maximum: 1
    patternProperties:
      '^(?!phandle$|pins$|groups$|function$)[a-zA-Z0-9_-]+$':
        $ref: '#/$defs/config-node'
    additionalProperties: false

examples:
  - |
    pinctrl {
        compatible = "stericsson,db8500-pinctrl";
        nomadik-gpio-chips = <&gpio0>, <&gpio1>;
        prcm = <&prcmu>;

        uart0 {
            uart0-default {
                mux {
                    function = "u0";
                    groups = "u0_a_1";
                };
                config {
                    pins = "GPIO0_AJ5";
                    ste,input = <1>;
                };
            };
        };
    };
```
